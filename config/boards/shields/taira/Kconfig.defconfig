## config/boards/shields/taira/Kconfig.defconfig
```kconfig
# Copyright (c) 2020 The ZMK Contributors
# SPDX-License-Identifier: MIT

if SHIELD_TIARA_LEFT

config ZMK_KEYBOARD_NAME
	default "Tiara"

config ZMK_SPLIT_BLE_ROLE_CENTRAL
	default y

endif

if SHIELD_TIARA_LEFT || SHIELD_TIARA_RIGHT

config ZMK_SPLIT
	default y

endif
```

## config/boards/shields/taira/Kconfig.shield
```kconfig
# Copyright (c) 2020 The ZMK Contributors
# SPDX-License-Identifier: MIT

config SHIELD_TIARA_LEFT
	def_bool $(shields_list_contains,tiara_left)

config SHIELD_TIARA_RIGHT
	def_bool $(shields_list_contains,tiara_right)
```

## config/boards/shields/tiara/Kconfig.defconfig
```kconfig
# Copyright (c) 2020 The ZMK Contributors
# SPDX-License-Identifier: MIT

if SHIELD_tiara_LEFT

config ZMK_KEYBOARD_NAME
	default "tiara"

config ZMK_SPLIT_BLE_ROLE_CENTRAL
	default y

endif

if SHIELD_tiara_LEFT || SHIELD_tiara_RIGHT

config ZMK_SPLIT
	default y

endif
```

## config/boards/shields/tiara/Kconfig.shield
```kconfig
# Copyright (c) 2020 The ZMK Contributors
# SPDX-License-Identifier: MIT

config SHIELD_tiara_LEFT
	def_bool $(shields_list_contains,tiara_left)

config SHIELD_tiara_RIGHT
	def_bool $(shields_list_contains,tiara_right)
```
